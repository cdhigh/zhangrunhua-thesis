;标号	指令	操作数	;注释
;循环，LED向左闪烁，再向右闪烁，循环往复			
	LIST	P=16F628A	
	INCLUDE	P16F628A.INC	
Tmp0	EQU	0X20	;定义临时寄存器
Tmp1	EQU	0X21	
CNT	EQU	0X22	
	ORG	0X00	
	BANKSEL	TRISB	
	CLRF	TRISB	
	CLRF	STATUS	
LOOP0	CLRF	CNT	
	MOVLW	B'00000001'	
	MOVWF	PORTB	
LOOP1	CALL	delay	;调用延时子程序
	BCF	STATUS,C	
	RLF	PORTB	
	BTFSS	STATUS,C	
	BCF	PORTB,0	
	BTFSC	STATUS,C	
	BSF	PORTB,0	
	INCF	CNT	
	MOVLW	D'7'	
	XORWF	CNT,W	
	BTFSS	STATUS,Z	
	GOTO	LOOP1	
	CLRF	CNT	
;	CALL	delay	
	MOVLW	B'10000000'	
	MOVWF	PORTB	
LOOP2	CALL	delay	
	BCF	STATUS,C	
	RRF	PORTB	
	BTFSS	STATUS,C	
	BCF	PORTB,7	
	BTFSC	STATUS,C	
	BSF	PORTB,7	
	INCF	CNT	
	MOVFW	CNT	
	XORLW	D'7'	
	BTFSS	STATUS,Z	
	GOTO	LOOP2	
	GOTO	LOOP0	
delay	;调用延时子程序		
	CLRF	Tmp0	
delayLoopA	CLRF	Tmp1	
delayLoopB	DECFSZ	Tmp1	
	GOTO	delayLoopB	
	DECFSZ	Tmp0	
	GOTO	delayLoopA	
	RETURN		
	END		
