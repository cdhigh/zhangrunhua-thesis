	LIST	P=12F675
	INCLUDE	P12F675.INC
	__CONFIG    _INTRC_OSC_NOCLKOUT & _PWRTE_ON & _BODEN_OFF & _CP_OFF & _WDT_ON 


	ORG	0
	BANKSEL	TRISIO
	CLRF	TRISIO
	BANKSEL	GPIO
	CLRF	GPIO
LOOP1	MOVLW	B'00000001'
	MOVWF	GPIO
	CALL	delay
	MOVLW	B'00000010'
	MOVWF	GPIO
	CALL	delay
	MOVLW	B'00000100'
	MOVWF	GPIO
	CALL	delay
	MOVLW	B'00001000'
	MOVWF	GPIO
	CALL	delay
	MOVLW	B'00010000'
	MOVWF	GPIO
	CALL	delay
	MOVLW	B'00100000'
	MOVWF	GPIO
	CALL	delay
	MOVLW	B'00010000'
	MOVWF	GPIO
	CALL	delay
	MOVLW	B'00001000'
	MOVWF	GPIO
	CALL	delay
	MOVLW	B'00000100'
	MOVWF	GPIO
	CALL	delay
	MOVLW	B'00000010'
	MOVWF	GPIO
	CALL	delay
	GOTO	LOOP1

delay	;子程序
	;功能:延时200ms
	;入口参数:无
	;出口参数:无
	;占用资源:Tmp1,Tmp2
	CLRF	Tmp1
delay200ms_1	CLRF	Tmp2
	DECFSZ	Tmp2
	GOTO	$-1
	DECFSZ	Tmp1
	GOTO	delay200ms_1
	RETURN
	END

